## conf/layer.conf
```bitbake
# We have a conf and classes directory, add to BBPATH
BBPATH .= ":${LAYERDIR}"

# We have recipes-* directories, add to BBFILES
BBFILES += "${LAYERDIR}/recipes-*/*/*.bb \
            ${LAYERDIR}/recipes-*/*/*.bbappend"

BBFILE_COLLECTIONS += "meta-pirate"
BBFILE_PATTERN_meta-pirate = "^${LAYERDIR}/"
BBFILE_PRIORITY_meta-pirate = "6"

LAYERDEPENDS_meta-pirate = "core"
LAYERSERIES_COMPAT_meta-pirate = "dunfell"
```
